## boards/shields/TakTil/Kconfig.defconfig
```kconfig
if SHIELD_TAKTIL

config ZMK_KEYBOARD_NAME
    default "TakTil"

endif # SHIELD_TAKTIL
```

## boards/shields/TakTil/Kconfig.shield
```kconfig
config SHIELD_TAKTIL
    def_bool $(shields_list_contains, TakTil)
    imply ZMK_MOUSE
	imply ZMK_TRACKPAD
    select I2C
```

## boards/shields/peacock_vik_module/Kconfig.defconfig
```kconfig
# Copyright (c) 2019 Linaro Limited
# SPDX-License-Identifier: Apache-2.0

if SHIELD_PEACOCK_VIK_MODULE

if ZMK_TRACKPAD

config ZMK_TRACKPAD_LOGICAL_X
	default 3072

config ZMK_TRACKPAD_LOGICAL_Y
	default 2048

config ZMK_TRACKPAD_PHYSICAL_X
	default 3072

config ZMK_TRACKPAD_PHYSICAL_Y
	default 2048

endif # ZMK_TRACKPAD

endif # SHIELD_PEACOCK_VIK_MODULE
```
