## boards/shields/taktyl/Kconfig.shield
```kconfig
config SHIELD_TAKTYL_LEFT
	def_bool $(shields_list_contains,taktyl_left)

config SHIELD_TAKTYL_RIGHT
	def_bool $(shields_list_contains,taktyl_right)
	imply ZMK_MOUSE
	select I2C
```

## drivers/input/Kconfig
```kconfig
# Copyright (c) 2024 The ZMK Contributors
# SPDX-License-Identifier: MIT

menuconfig INPUT_AZOTEQ_IQS5XX
    bool "Azoteq IQS5xx trackpads"
    default y
    depends on GPIO
    depends on I2C
    depends on INPUT
    depends on DT_HAS_AZOTEQ_IQS5XX_ENABLED
    help
      Enable driver for Azoteq IQS5xx trackpads (mode Windows Precision Touchpad).

if INPUT_AZOTEQ_IQS5XX

config INPUT_AZOTEQ_IQS5XX_INIT_PRIORITY
    int "Azoteq IQS5xx initialization priority"
    default INPUT_INIT_PRIORITY
    help
      Driver initialization priority for the IQS5xx driver.
      Lower values initialize earlier.

endif # INPUT_AZOTEQ_IQS5XX

menuconfig ANALOG_INPUT
    bool "Entree analogique (joystick) sur ADC"
    depends on INPUT
    select ADC
    help
      Lit des canaux ADC et emet leur deflexion comme evenements d'entree.

if ANALOG_INPUT

config ANALOG_INPUT_WORKQUEUE_PRIORITY
    int "Priorite de la workqueue d'echantillonnage"
    default 10

config ANALOG_INPUT_WORKQUEUE_STACK_SIZE
    int "Taille de pile de la workqueue d'echantillonnage"
    default 1024

module = ANALOG_INPUT
module-str = ANALOG_INPUT
source "${ZEPHYR_BASE}/subsys/logging/Kconfig.template.log_config"

endif # ANALOG_INPUT

config ZMK_JOYSTICK_ARROWS
    bool "Joystick vers touches flechees"
    default y
    depends on INPUT
    depends on DT_HAS_ZMK_JOYSTICK_ARROWS_ENABLED
    help
      Transforme les axes d'un joystick analogique en appuis sur les fleches.

config ZMK_INPUT_ACTIVITY
    bool "Les evenements d'entree comptent comme activite ZMK"
    default y
    depends on INPUT
    help
      Empeche la mise en veille profonde pendant l'utilisation du pave tactile
      ou du joystick.

config ZMK_BEHAVIOR_PTP_BUTTON
    bool "Behavior &ptp_btn : clics dans le rapport Precision Touchpad"
    default y
    depends on ZMK_TRACKPAD
    depends on DT_HAS_ZMK_BEHAVIOR_PTP_BUTTON_ENABLED
```

## dts/bindings/behaviors/zmk,behavior-ptp-button.yaml
```yaml
description: |
  Boutons de souris (LCLK, RCLK, MCLK) envoyes dans le rapport Windows
  Precision Touchpad. A utiliser a la place de &mkp quand le pave est en mode PTP.

compatible: "zmk,behavior-ptp-button"

include: one_param.yaml
```

## dts/bindings/input/azoteq,iqs5xx-common.yaml
```yaml
# Proprietes communes du driver Azoteq IQS5xx (mode Windows Precision Touchpad).
properties:
  rdy-gpios:
    type: phandle-array
    required: true
    description: "Broche RDY (donnees pretes) de l'IQS5xx"

  reset-gpios:
    type: phandle-array
    description: |
      Broche reset de l'IQS5xx. Fortement recommandee : elle sert a relancer
      le capteur en cas d'erreur I2C et au reveil.

  switch-xy:
    type: boolean
    description: "Echange les axes X et Y"

  flip-x:
    type: boolean
    description: "Inverse le sens de l'axe X"

  flip-y:
    type: boolean
    description: "Inverse le sens de l'axe Y"

  palm_rejection:
    type: boolean
    description: "Active le rejet de la paume de l'IQS5xx"

  palm_reject_threshold:
    type: int
    default: 100
    description: "Surface a partir de laquelle un contact est considere comme une paume"

  palm_reject_timeout:
    type: int
    default: 4
    description: "Delai avant de desactiver le rejet de paume (multiple de 32 ms)"

  max_touch_number:
    type: int
    default: 5
    description: "Nombre maximum de doigts suivis (1 a 5)"

  resolution_x:
    type: int
    default: 3072
    description: "Resolution de sortie de l'axe X"

  resolution_y:
    type: int
    default: 2048
    description: "Resolution de sortie de l'axe Y"

  bottom-beta:
    type: int
    default: 5
    description: |
      Filtrage aux faibles vitesses.
      0 : filtrage maximal (lisse mais plus de latence), 255 : filtrage minimal.

  stationary-threshold:
    type: int
    default: 5
    description: "Deplacement (en points) en dessous duquel un doigt est considere immobile"

  report_rate_active_mode:
    type: int
    default: 8
    description: "Intervalle de rapport (ms) quand un doigt bouge ou est pose"

  report_rate_idle_mode:
    type: int
    default: 16
    description: |
      Intervalle de rapport (ms) sans doigt pose. Fixe le delai maximal de
      detection du premier toucher.

  report_rate_lp1_mode:
    type: int
    default: 40
    description: "Intervalle de rapport (ms) en basse consommation 1 (apres idle_timeout)"

  report_rate_lp2_mode:
    type: int
    default: 100
    description: "Intervalle de rapport (ms) en basse consommation 2 (apres une longue inactivite)"

  idle_timeout:
    type: int
    default: 20
    description: "Secondes sans toucher avant de passer en basse consommation 1 (255 = jamais)"
```

## dts/bindings/input/zmk,joystick-arrows.yaml
```yaml
description: |
  Transforme la deflexion d'un joystick analogique (axes X / Y) en appuis
  sur les touches flechees gauche / droite / haut / bas.

compatible: "zmk,joystick-arrows"

properties:
  device:
    type: phandle
    required: true
    description: "Device d'entree a ecouter (ex. le noeud zmk,analog-input)"

  threshold:
    type: int
    default: 150
    description: "Deflexion (en mV hors zone morte) a partir de laquelle la fleche est appuyee"

  release-threshold:
    type: int
    default: 75
    description: "Deflexion en dessous de laquelle la fleche est relachee (doit etre < threshold)"
```
